## config/west.yml
```yaml
manifest:
  remotes:
    - name: zmkfirmware
      url-base: https://github.com/zmkfirmware
    - name: infused-kim
      url-base: https://github.com/infused-kim
    - name: dnlbauer
      url-base: https://github.com/dnlbauer
    - name: tklzg
      url-base: https://github.com/tklzg
  projects:
    - name: zmk
      import: app/west.yml
   #  remote: dnlbauer
   #  revision: waterfowl-encoders
      remote: tklzg
      revision: encoder
   #  remote: infused-kim
   #  revision: sofle
   #  remote: zmkfirmware
   #  revision: main
  self:
    path: config
```
